## arch/arm/cpu/armv8/coreboot/Kconfig
```kconfig
config SYS_COREBOOT
	bool "Support for booting u-boot as a coreboot payload"
	imply SCSI
	imply SCSI_AHCI
	imply AHCI_PCI
	imply MMC
	imply MMC_PCI
	imply MMC_SDHCI
	imply MMC_SDHCI_SDMA
	imply USB
	imply USB_EHCI_HCD
	imply USB_XHCI_HCD
	imply USB_STORAGE
	imply USB_KEYBOARD
	imply ETH_DESIGNWARE
	imply RTL8169
	imply CMD_CBFS
	imply FS_CBFS
	imply CBMEM_CONSOLE
	imply USE_PREBOOT
	select SYSINFO
	imply SYSINFO_EXTRA
```

## configs/chromebook_trogdor_defconfig
```kconfig
CONFIG_ARM=y
CONFIG_SYS_VENDOR="google"
CONFIG_SYS_BOARD="trogdor"
CONFIG_SYS_CONFIG_NAME="qcom"
CONFIG_SKIP_LOWLEVEL_INIT=y
CONFIG_POSITION_INDEPENDENT=y
CONFIG_ARCH_SNAPDRAGON=y
CONFIG_TEXT_BASE=0x80c00000
CONFIG_SYS_MALLOC_LEN=0x4000000
CONFIG_NR_DRAM_BANKS=32
CONFIG_DEFAULT_DEVICE_TREE="qcom/sc7180-trogdor-lazor-r3-lte"
CONFIG_SYS_LOAD_ADDR=0x80000000
CONFIG_REMAKE_ELF=y
CONFIG_SYS_COREBOOT=y
CONFIG_EFI_RT_VOLATILE_STORE=y
CONFIG_EFI_SCROLL_ON_CLEAR_SCREEN=y
# CONFIG_BOOTEFI_HELLO_COMPILE is not set
# CONFIG_BOOTEFI_TESTAPP_COMPILE is not set
CONFIG_FIT=y
CONFIG_FIT_BEST_MATCH=y
CONFIG_BOOTSTD_FULL=y
# CONFIG_BOOTSTD_DEFAULTS is not set
# CONFIG_EXPO is not set
# CONFIG_BOOTMETH_SCRIPT is not set
CONFIG_BOOTSTAGE=y
CONFIG_BOOTSTAGE_FDT=y
CONFIG_SD_BOOT=y
CONFIG_AUTOBOOT_KEYED=y
CONFIG_AUTOBOOT_STOP_STR="!"
CONFIG_AUTOBOOT_KEYED_CTRLC=y
CONFIG_AUTOBOOT_MENU_SHOW=y
# CONFIG_ARCH_FIXUP_FDT_MEMORY is not set
# CONFIG_USE_PREBOOT is not set
CONFIG_LOGLEVEL=9
CONFIG_CONSOLE_FLUSH_ON_NEWLINE=y
# CONFIG_CONSOLE_MUX is not set
# CONFIG_SYS_DEVICE_NULLDEV is not set
CONFIG_LOG_MAX_LEVEL=9
CONFIG_LOG_DEFAULT_LEVEL=3
# CONFIG_DISPLAY_CPUINFO is not set
# CONFIG_DISPLAY_BOARDINFO is not set
# CONFIG_CYCLIC is not set
CONFIG_HUSH_PARSER=y
# CONFIG_BOOTM_PLAN9 is not set
# CONFIG_BOOTM_RTEMS is not set
# CONFIG_CMD_VBE is not set
CONFIG_CMD_BOOTMENU=y
CONFIG_CMD_SHA1SUM=y
CONFIG_SHA1SUM_VERIFY=y
CONFIG_CMD_CLK=y
CONFIG_CMD_GPIO=y
CONFIG_CMD_GPT=y
CONFIG_CMD_I2C=y
CONFIG_CMD_LOADM=y
CONFIG_CMD_MBR=y
CONFIG_CMD_MISC=y
CONFIG_CMD_MMC=y
CONFIG_CMD_BKOPS_ENABLE=y
CONFIG_CMD_PART=y
CONFIG_CMD_READ=y
CONFIG_CMD_SPI=y
CONFIG_DEFAULT_SPI_BUS=6
CONFIG_CMD_USB=y
# CONFIG_CMD_CLS is not set
CONFIG_CMD_PSTORE=y
CONFIG_CMD_PSTORE_MEM_ADDR=0x0
CONFIG_CMD_PSTORE_RECORD_SIZE=0x40000
CONFIG_CMD_PSTORE_CONSOLE_SIZE=0x40000
CONFIG_CMD_PSTORE_FTRACE_SIZE=0x20000
CONFIG_CMD_PSTORE_PMSG_SIZE=0x20000
CONFIG_CMD_BOOTSTAGE=y
CONFIG_CMD_REGULATOR=y
CONFIG_CMD_EXT2=y
CONFIG_CMD_EXT4=y
CONFIG_CMD_FAT=y
CONFIG_CMD_FS_GENERIC=y
CONFIG_CMD_LOG=y
CONFIG_PARTITION_TYPE_GUID=y
CONFIG_OF_LIVE=y
# CONFIG_OF_TAG_MIGRATE is not set
CONFIG_DM_WARN=y
# CONFIG_OFNODE_MULTI_TREE is not set
# CONFIG_SCSI_AHCI is not set
CONFIG_CLK=y
CONFIG_CLK_STUB=y
CONFIG_CLK_QCOM_SC7180=y
CONFIG_MSM_GPIO=y
CONFIG_DM_I2C=y
CONFIG_I2C_CROS_EC_TUNNEL=y
CONFIG_SYS_I2C_GENI=y
CONFIG_CROS_EC_KEYB=y
CONFIG_MISC=y
CONFIG_CROS_EC=y
CONFIG_CROS_EC_SPI=y
# CONFIG_MMC_PCI is not set
CONFIG_MMC_SDHCI_MSM=y
# CONFIG_ETH_DESIGNWARE is not set
CONFIG_PHY=y
CONFIG_PHY_QCOM_QUSB2=y
CONFIG_PINCTRL=y
CONFIG_PINCONF=y
CONFIG_PINCTRL_QCOM_SC7180=y
CONFIG_DM_REGULATOR=y
CONFIG_DM_REGULATOR_FIXED=y
CONFIG_DM_REGULATOR_GPIO=y
CONFIG_DM_PWM=y
CONFIG_PWM_CROS_EC=y
# CONFIG_SCSI is not set
CONFIG_SPECIFY_CONSOLE_INDEX=y
CONFIG_CONS_INDEX=0
# CONFIG_COREBOOT_SERIAL is not set
# CONFIG_SYS_NS16550 is not set
CONFIG_MSM_GENI_SERIAL=y
CONFIG_SOC_QCOM=y
CONFIG_QCOM_COMMAND_DB=y
CONFIG_QCOM_RPMH=y
CONFIG_SPI=y
CONFIG_DM_SPI=y
CONFIG_SPI_GENI_QCOM=y
# CONFIG_DM_USB_GADGET is not set
CONFIG_USB_DWC3=y
CONFIG_USB_DWC3_GENERIC=y
CONFIG_USB_HOST_ETHER=y
CONFIG_USB_ETHER_RTL8152=y
CONFIG_VIDEO=y
CONFIG_VIDEO_PCI_DEFAULT_FB_SIZE=0x1000
CONFIG_VIDEO_MIPI_DSI=y
# CONFIG_SIMPLE_PANEL is not set
CONFIG_BMP=y
CONFIG_VIDEO_BMP_GZIP=y
CONFIG_BMP_16BPP=y
CONFIG_BMP_24BPP=y
CONFIG_BMP_32BPP=y
# CONFIG_RANDOM_UUID is not set
# CONFIG_SHA256 is not set
CONFIG_ZLIB_UNCOMPRESS=y
CONFIG_BZIP2=y
CONFIG_ZSTD=y
```

## drivers/video/qcom/Kconfig
```kconfig
#

menuconfig VIDEO_QCOM
	bool "Enable Qualcomm Video Support"
	depends on VIDEO
	help
	  Qualcomm SoCs provide video output capabilities for High-Definition
	  Multimedia Interface (HDMI), Low-voltage Differential Signalling
	  (LVDS), embedded DisplayPort (eDP) and Display Serial Interface (DSI).

if VIDEO_QCOM

config DISPLAY_QCOM_MIPI
	bool "MIPI Port"
	depends on VIDEO_QCOM
	help
	  This enables Mobile Industry Processor Interface (MIPI) display
	  support. The MIPI controller sc7180 support.

endif
```

## lib/coreboot/Kconfig
```kconfig
menu "U-Boot as Coreboot payload"
	depends on VENDOR_COREBOOT

config SYS_COREBOOT
	bool
	default y
	imply SYS_NS16550
	imply SCSI
	imply SCSI_AHCI
	imply AHCI_PCI
	imply MMC
	imply MMC_PCI
	imply MMC_SDHCI
	imply MMC_SDHCI_SDMA
	imply USB
	imply USB_EHCI_HCD
	imply USB_XHCI_HCD
	imply USB_STORAGE
	imply USB_KEYBOARD
	imply VIDEO_COREBOOT
	imply E1000
	imply ETH_DESIGNWARE
	imply PCH_GBE
	imply RTL8169
	imply CMD_CBFS
	imply FS_CBFS
	imply CBMEM_CONSOLE
	imply X86_TSC_READ_BASE
	imply USE_PREBOOT
	select BINMAN if X86_RUN_64BIT
	select SYSINFO
	imply SYSINFO_EXTRA

config COREBOOT_SYSINFO
	bool "Support reading coreboot sysinfo"
	default y if SYS_COREBOOT
	help
	  Select this option to read the coreboot sysinfo table on start-up,
	  if present. This is written by coreboot before it exits and provides
	  various pieces of information about the running system, including
	  display, memory and build information. It is stored in
	  struct sysinfo_t after parsing by get_coreboot_info().

config SPL_COREBOOT_SYSINFO
	bool "Support reading coreboot sysinfo"
	depends on SPL
	default y if COREBOOT_SYSINFO
	help
	  Select this option to read the coreboot sysinfo table in SPL,
	  if present. This is written by coreboot before it exits and provides
	  various pieces of information about the running system, including
	  display, memory and build information. It is stored in
	  struct sysinfo_t after parsing by get_coreboot_info().

endmenu
```
